#include <Arduino.h>

/**
  SePoLab SMART Devices PROJECT
  Name: IRControlerNode
  Purpose: Give command to Air Conditioner as Remote Controller
  General Hardware:
  - BASE: 
  -- WeMosD1mini/WeMosD1miniPro(required if supported upgrade firmware via OTA) / WeMosD1Lite (no OTA support)
  - SHIELD:
  -- DYI IR remote shield (required) - used Port: D7
  -- 1-BUTTON shield (optional) - used Port: D3
  -- RGB LED Shield (optional) - used Port: D2
  - CONNECTION:
  -- SOFT RESET BUTTON: D3 => use to reset WiFi or MQTT server connection
  -- LED INDICATER: D2 => use to inform status of Connection

Pin Function                          ESP-8266 Pin
TX  TXD                                     TXD
RX  RXD                                     RXD
A0  Analog input                            A0
D0  IO                                      GPIO16
D1  IO, SCL                                 GPIO5
D2  IO, SDA                                 GPIO4
D3  IO, 10k Pull-up                         GPIO0
D4  IO, 10k Pull-up, BUILTIN_LED            GPIO2
D5  IO, SCK                                 GPIO14
D6  IO, MISO                                GPIO12
D7  IO, MOSI                                GPIO13
D8  IO, 10k Pull-down, SS                   GPIO15
G   Ground                                  GND
5V  5V                                      -
3V3 3.3V                                    3.3V
RST Reset                                   RST

  General Sofware:
  - Connect to MQTT Server: will input in WiFi Configuration.
  -- Subcrible topic: <ProjectName>/<MacAddress>/set
  -- Publish topic: <ProjectName>/<MacAddress>/state
  -- Command from MQTT Broker = {"DT":"AC/WF","B":"Toshiba","State":"on","M":"cool","T":"27","F":"max","S":"n"}
M
  @author Sebastian sepolab@gmail.com
  @version 1.0 6/15/17
########################################
  - OTA Update: basic update via ArduinoOTA library
  - Impacted on:
    -- setup_wifi(): configurate OTA
    -- loop(): looping OTA checking
  @version 1.1 7/15/17
*/

#include <WiFiManager.h>          //https://github.com/tzapu/WiFiManager version 0.11.0
#include <ESP8266WiFi.h>          //https://github.com/esp8266/Arduino version 1.0.0
#include <DNSServer.h>            // version 1.1.0
#include <ESP8266WebServer.h>     // version 1.0.0
#include <ArduinoJson.h>          //https://github.com/bblanchon/ArduinoJson version 5.1.0
#include <FS.h>
#include <PubSubClient.h> //April23 version 2.6.0
#include "math.h"
#include <Adafruit_NeoPixel.h>    //https://github.com/adafruit/Adafruit_NeoPixel version 1.1.1
#include <IRDaikinESP.h>
#include <IRremoteESP8266.h>
#include <ESP8266mDNS.h>
#include <WiFiUdp.h>
#include <ArduinoOTA.h>

IRDaikinESP dakinir(D7);
IRsend irsend(13); //an IR led is connected to GPIO pin 13 -D7
//Example signals from various Toshiba AC units (very long signals)
const unsigned int AC_Toshiba_irSignalOpenAt27FullFan[] PROGMEM = {4372,4364,540,1628,532,1632,528,1628,532,1628,532,548,532,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616,460};
const unsigned int AC_Toshiba_irSignalCloseAt27FullFan[] PROGMEM = {4396,4340,540,1628,532,1624,536,1624,536,1628,532,552,532,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572,508};
const unsigned int AC_Daikin_irSignalCloseAt27FullFan[] PROGMEM = {3476,1740,392,1296,428,476,388,432,428,476,384,1300,432,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1336,388};

const unsigned int To12840[] PROGMEM = {4328,4408,496,1628,532,1632,528,1632,528,1632,528,552,532,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536,492};
const unsigned int To12810[] PROGMEM = {4392,4364,536,1632,532,1632,528,1628,532,1624,536,548,532,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548,532};
const unsigned int To12820[] PROGMEM = {4328,4368,536,1640,520,1632,528,1668,492,1628,532,556,528,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592,492};
const unsigned int To12830[] PROGMEM = {4332,4364,536,1668,544,1580,528,1672,492,1628,532,552,528,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592,488};

const unsigned int To12740[] PROGMEM = {4400,4340,536,1628,532,1628,532,1628,532,1628,532,572,508,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548,532};
const unsigned int To12710[] PROGMEM = {4424,4312,536,1628,536,1628,532,1624,536,1628,532,552,528,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580,500};
const unsigned int To12720[] PROGMEM = {4372,4364,540,1628,532,1628,532,1632,528,1628,532,552,528,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572,508};
const unsigned int To12730[] PROGMEM = {4420,4336,540,1624,532,1628,536,1624,536,1628,532,596,484,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556,524};

const unsigned int To12640[] PROGMEM = {4424,4356,496,1628,532,1668,492,1636,524,1632,532,548,528,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592,488};
const unsigned int To12610[] PROGMEM = {4372,4364,540,1628,532,1628,532,1628,532,1628,532,548,532,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572,508};
const unsigned int To12620[] PROGMEM = {4424,4356,496,1628,528,1672,544,1576,532,1628,532,552,528,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552,532};
const unsigned int To12630[] PROGMEM = {4384,4352,496,1628,532,1668,492,1668,492,1632,532,572,504,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552,524};

const unsigned int To12540[] PROGMEM = {4372,4364,540,1628,532,1628,532,1628,532,1676,484,620,460,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548,536};
const unsigned int To12510[] PROGMEM = {4396,4340,540,1620,540,1624,548,1612,536,1624,536,548,564,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548,532};
const unsigned int To12520[] PROGMEM = {4372,4368,536,1628,532,1628,536,1624,532,1632,532,548,528,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548,532};
const unsigned int To12530[] PROGMEM = {4396,4340,536,1632,528,1656,508,1628,532,1628,532,548,532,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548,532};

const unsigned int To12841[] PROGMEM = {4400,4384,520,1596,540,1620,536,1624,540,1620,540,544,560,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544,536};
const unsigned int To12831[] PROGMEM = {4356,4384,492,1668,496,1664,496,1664,492,1668,496,584,496,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588,492};
const unsigned int To12811[] PROGMEM = {4400,4336,540,1624,536,1624,536,1624,564,1596,540,540,536,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544,540};
const unsigned int To12821[] PROGMEM = {4420,4340,536,1624,536,1624,536,1624,536,1624,564,516,540,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520,536};

const unsigned int To12721[] PROGMEM = {4360,4336,540,1620,536,1624,536,1628,532,1668,492,548,536,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548,536};
const unsigned int To12731[] PROGMEM = {4396,4380,496,1672,492,1624,532,1632,532,1628,528,592,492,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588,496};
const unsigned int To12741[] PROGMEM = {4352,4384,496,1672,488,1668,492,1668,496,1668,488,592,492,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592,492};
const unsigned int To12711[] PROGMEM = {4400,4336,540,1624,560,1600,564,1596,540,1620,564,516,564,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544,536};

const unsigned int To12611[] PROGMEM = {4404,4336,568,1592,568,1592,568,1592,568,1596,564,516,564,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516,540};
const unsigned int To12621[] PROGMEM = {4404,4336,564,1600,536,1624,564,1596,544,1616,568,512,564,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540,564};
const unsigned int To12631[] PROGMEM = {4400,4336,568,1596,564,1596,568,1592,564,1596,568,512,568,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516,564};
const unsigned int To12641[] PROGMEM = {4404,4336,536,1624,536,1624,540,1620,536,1624,540,540,536,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544,536};

const unsigned int To12541[] PROGMEM = {4400,4336,540,1664,524,1596,536,1624,536,1624,540,540,536,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540,540};
const unsigned int To12511[] PROGMEM = {4396,4380,500,1668,492,1668,492,1668,492,1664,492,592,492,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588,492};
const unsigned int To12521[] PROGMEM = {4400,4340,560,1600,536,1624,536,1624,540,1620,560,520,560,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544,536};
const unsigned int To12531[] PROGMEM = {4416,4380,496,1664,496,1668,492,1668,496,1664,492,588,496,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584,496};

const unsigned int WFPaPo[] PROGMEM = {3496,3468,868,2612,868,2608,872,872,868,2612,868,2612,868,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872,868};
const unsigned int WFPaSp[] PROGMEM = {3480,3480,872,2608,872,2612,868,872,868,2616,864,2616,864,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2560,864};
const unsigned int WFPaOs[] PROGMEM = {3480,3480,868,2612,872,2612,868,872,868,2608,872,2612,868,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2612,868};
const unsigned int WFPaTi[] PROGMEM = {3540,3424,868,2612,868,2612,868,876,864,2612,920,2564,864,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2612,868};
const unsigned int WFPaRh[] PROGMEM = {3508,3484,864,2616,888,2592,864,872,868,2620,860,2612,868,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2620,888};

const unsigned int WFMiPo[] PROGMEM = {3248,1616,352,1252,356,1252,324,424,392,448,368,400,392,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1232,376};
const unsigned int WFMiSp[] PROGMEM = {3196,1624,372,1248,356,1232,376,396,392,396,420,396,420,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1208,396};
const unsigned int WFMiOs[] PROGMEM = {3216,1580,396,1184,420,1184,420,400,388,396,420,396,420,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1188,416};
const unsigned int WFMiTi[] PROGMEM = {3236,1568,420,1188,420,1188,388,396,424,392,420,396,392,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1184,420};
const unsigned int WFMiRh[] PROGMEM = {3196,1600,396,1248,356,1232,372,400,392,396,420,396,420,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1248,356};


//---------SOFT RESET BUTTON PARAMETERS---------------------
const int SOFT_RST_PIN = D3;      // SOFT RESET button is map to port 0
int buttonState;             // the current reading from the input pin
int lastButtonState = LOW;   // the previous reading from the input pin
// the following variables are long's because the time, measured in miliseconds,
// will quickly become a bigger number than can be stored in an int.
long lastDebounceTime = 0;  // the last time the output pin was toggled
long debounceDelay = 1000;    // the debounce time; increase if the output flickers
unsigned long previousMillis2 = 0;
//--------LED INDICATION PARAMETERS--------------------
#define PINLED D2

// When we setup the NeoPixel library, we tell it how many pixels, and which pin to use to send signals.
// Note that for older NeoPixel strips you might need to change the third parameter--see the strandtest
// example for more information on possible values.
Adafruit_NeoPixel pixels = Adafruit_NeoPixel(1, PINLED, NEO_GRB + NEO_KHZ800);
//----------------WIFI CHECK STATE PAMAMETERS----------------
int check = 0;
bool checkWifi = false; //wifi connect indication 0: disconnect; 1: connected
bool mqttReconnecting = false;
//------------WIFI CONFIGURATION PARAMETERS--------------------
bool factoryReset = false;
char APssid[20] = ""; //AP is ESP will connect
char APpassword[20] = "";
const char ssid[20] = ""; // ESP in AP mode
const char password[] = "password";
WiFiClient espClient; //April23
byte mac[6];
//--------------MQTT client PRAMETERS--------------
//define mqtt server default values here, if there are different values in config.json, they are overwritten.
char mqttServer[40] = ""; //April24
char mqttPort[6] = "1883"; //April24
char projectName[40] = "";
char blynk_token[34] = "YOUR_BLYNK_TOKEN";
//flag for saving data
bool shouldSaveConfig = false;
PubSubClient client(espClient);//April23
unsigned long previousMillis3 = 0; //set time for interval publish
unsigned long previousMillis4 = 0; //set time for interval publish
//char mqttClientID[] = ssid;
char pubTopicGen[50] = "";
char subTopicGen[50] = "";
int valueOfSensor = 0;// value that will be published
char pubMsg[150] = "Hello Server,it is client's 1st message!";//payload of publishing message
char subMsg[150]; //payload of subcribled message
long publishInveral = 15000;
bool mqttConnected = false;
const long reconnectInveral = 10000;
bool firstTime = true;
char temptMac[20] = "";
//------------------------
bool isDefinedCommand = true;
bool simulatedDropedWifi = false;
char ID[20];
char DeviceType[5];
//----------AC CONFIGURATION---------------
char ACID[20];
char ACstate[4] = "Off"; // on or off
char ACmode[5] = "Cool"; // cool; dry; fan; auto
char ACtemp[3] = "27"; // from 16 - 30
char ACfan[5] = "Max"; // min, med, max, auto
char ACswing[4] = "Off"; // On/Off
char finalResult[10];
//----------AC CONFIGURATION---------------
char WFID[20];
char WFCommand[7] = "none"; // on or off
char finResult[7];
// END OF VARIABLES--------------------------


//------------------------------------------------------------
//PROCEDURE: CONVERT AC REQUEST TO AC VARIABLE NAME
//------------------------------------------------------------
//PROCESS BY DATE:
// JUL22,2016: 
//    
//------------------------------------------------------------
bool convertToWFVariableName(char brand[],char comm[]) {
  bool isValid = true;
  char bufB[3] = "00";
  if ((brand[0] == 'M') and (brand[1] == 'i') and (brand[2] == 't') and (brand[3] == 's') and (brand[4] == 'h') and (brand[5] == 'u') and (brand[6] == 'b'))
    {snprintf(bufB, 3,"Mi");}
  else if ((brand[0] == 'P') and (brand[1] == 'a') and (brand[2] == 'n') and (brand[3] == 'a') and (brand[4] == 's') and (brand[5] == 'o') and (brand[6] == 'n') and (brand[7] == 'i') and (brand[8] == 'c'))
    {snprintf(bufB, 3,"Pa");}
  else if ((brand[0] == 'D') and (brand[1] == 'a') and (brand[2] == 'i') and (brand[3] == 'k') and (brand[4] == 'i') and (brand[5] == 'n'))
    {snprintf(bufB, 3,"Da");}
  else {isValid == false;}

  char bufC[3] = "00";
  if ((comm[0] == 'p') and (comm[1] == 'o') and (comm[2] == 'w') and (comm[3] == 'e') and (comm[4] == 'r')) {snprintf(bufC, 3,"Po");}
  else if ((comm[0] == 's') and (comm[1] == 'p') and (comm[2] == 'e') and (comm[3] == 'e') and (comm[4] == 'd')) {snprintf(bufC, 3,"Sp");}
  else if ((comm[0] == 'o') and (comm[1] == 's') and (comm[2] == 'c') and (comm[3] == 'i') and (comm[4] == 'l')) {snprintf(bufC, 3,"Os");}
  else if ((comm[0] == 't') and (comm[1] == 'i') and (comm[2] == 'm') and (comm[3] == 'e') and (comm[4] == 'r')) {snprintf(bufC, 3,"Ti");}
  else if ((comm[0] == 'r') and (comm[1] == 'h') and (comm[2] == 'y') and (comm[3] == 't') and (comm[4] == 'h')) {snprintf(bufC, 3,"Rh");}
  else {isValid == false;}

  if (isValid) {
    snprintf(finResult, 7,"WF%s%s",bufB,bufC);
    Serial.print("Covert to variable Name: ");Serial.println(finResult);
    return true;
    isDefinedCommand = true;
  } else {
    return false;
    snprintf(finResult, 7,"failed");
    isDefinedCommand = false;
  }
}
void adjustWF() {
//  if (readReceivedMsgInWFJson(breakedValue)) { // PARSE DATA SUCCESSFULLY
      if (convertToWFVariableName(WFID,WFCommand)) {
            Serial.print("IR sent code: ");
            if ((finResult[0] == 'W') and (finResult[1] == 'F')) {
              if ((finResult[2] == 'M') and (finResult[3] == 'i')) {
                if ((finResult[4] == 'P') and (finResult[5] == 'o')) {
                  Serial.println("WFMiPo");
                  sendRAW_Flash(WFMiPo, sizeof(WFMiPo)/sizeof(int),38);
                } else
                if ((finResult[4] == 'S') and (finResult[5] == 'p')) {
                  Serial.println("WFMiSp");
                  sendRAW_Flash(WFMiSp, sizeof(WFMiSp)/sizeof(int),38);
                } else
                if ((finResult[4] == 'O') and (finResult[5] == 's')) {
                  Serial.println("WFMiOs");
                  sendRAW_Flash(WFMiOs, sizeof(WFMiOs)/sizeof(int),38);
                } else
                if ((finResult[4] == 'T') and (finResult[5] == 'i')) {
                  Serial.println("WFMiTi");
                  sendRAW_Flash(WFMiTi, sizeof(WFMiTi)/sizeof(int),38);
                } else
                if ((finResult[4] == 'R') and (finResult[5] == 'h')) {
                  Serial.println("WFMiRh");
                  sendRAW_Flash(WFMiRh, sizeof(WFMiRh)/sizeof(int),38);
                } else { Serial.println("WFMi Not Found");}
              } else 
              if ((finResult[2] == 'P') and (finResult[3] == 'a')) {
                if ((finResult[4] == 'P') and (finResult[5] == 'o')) {
                  Serial.println("WFPaPo");
                  sendRAW_Flash(WFPaPo, sizeof(WFPaPo)/sizeof(int),38);
                } else
                if ((finResult[4] == 'S') and (finResult[5] == 'p')) {
                  Serial.println("WFPaSp");
                  sendRAW_Flash(WFPaSp, sizeof(WFPaSp)/sizeof(int),38);
                } else
                if ((finResult[4] == 'O') and (finResult[5] == 's')) {
                  Serial.println("WFPaOs");
                  sendRAW_Flash(WFPaOs, sizeof(WFPaOs)/sizeof(int),38);
                } else
                if ((finResult[4] == 'T') and (finResult[5] == 'i')) {
                  Serial.println("WFPaTi");
                  sendRAW_Flash(WFPaTi, sizeof(WFPaTi)/sizeof(int),38);
                } else
                if ((finResult[4] == 'R') and (finResult[5] == 'h')) {
                  Serial.println("WFPaRh");
                  sendRAW_Flash(WFPaRh, sizeof(WFPaRh)/sizeof(int),38);
                } else { Serial.println("WFPa Not Found");}
              }
            }
}}

void adjustAC() {
//  if (readReceivedMsgInACJson(breakedValue)) { // PARSE DATA SUCCESSFULLY
    if ((ACstate[1] == 'f') and (ACstate[2] == 'f')) {
      Serial.println("AC_Toshiba_irSignalCloseAt27FullFan");
      sendRAW_Flash(AC_Toshiba_irSignalCloseAt27FullFan, sizeof(AC_Toshiba_irSignalCloseAt27FullFan)/sizeof(int),38);
    } else
      if (convertToACVariableName(ACID,ACmode,ACtemp,ACfan,ACswing)) {
            Serial.print("IR sent code: ");
            if ((finalResult[0] == 'T') and (finalResult[1] == 'o')) {
              if (finalResult[2] == '1') {
                if ((finalResult[3] == '2') and (finalResult[4] == '8')) {
                  if (finalResult[5] == '4') {
                    if (finalResult[6] == '0') {
                      Serial.println("To12840");
                      sendRAW_Flash(To12840, sizeof(To12840)/sizeof(int),38);
                    } else {
                      if (finalResult[6] == '1') {
                        Serial.println("To12841");
                        sendRAW_Flash(To12841, sizeof(To12841)/sizeof(int),38);
                      }
                    }
                  } else 
                  if (finalResult[5] == '3') {
                    if (finalResult[6] == '0') {
                      Serial.println("To12830");
                      sendRAW_Flash(To12830, sizeof(To12830)/sizeof(int),38);
                    } else {
                      if (finalResult[6] == '1') {
                        Serial.println("To12831");
                        sendRAW_Flash(To12831, sizeof(To12831)/sizeof(int),38);
                      }
                    }
                  } else
                  if (finalResult[5] == '2') {
                    if (finalResult[6] == '0') {
                      Serial.println("To12820");
                      sendRAW_Flash(To12820, sizeof(To12820)/sizeof(int),38);
                    } else {
                      if (finalResult[6] == '1') {
                        Serial.println("To12821");
                        sendRAW_Flash(To12821, sizeof(To12821)/sizeof(int),38);
                      }
                    }
                  } else
                  if (finalResult[5] == '1') {
                    if (finalResult[6] == '0') {
                      Serial.println("To12810");
                      sendRAW_Flash(To12810, sizeof(To12810)/sizeof(int),38);
                    } else {
                      if (finalResult[6] == '1') {
                        Serial.println("To12811");
                        sendRAW_Flash(To12811, sizeof(To12811)/sizeof(int),38);
                      }
                    }
                  }
                } else
                if ((finalResult[3] == '2') and (finalResult[4] == '7')) {
                  if (finalResult[5] == '4') {
                    if (finalResult[6] == '0') {
                      Serial.println("To12740");
                      sendRAW_Flash(To12740, sizeof(To12740)/sizeof(int),38);
                    }else {
                      if (finalResult[6] == '1') {
                        Serial.println("To12741");
                        sendRAW_Flash(To12741, sizeof(To12741)/sizeof(int),38);
                      }
                    }
                  } else 
                  if (finalResult[5] == '3') {
                    if (finalResult[6] == '0') {
                      Serial.println("To12730");
                      sendRAW_Flash(To12730, sizeof(To12730)/sizeof(int),38);
                    }else {
                      if (finalResult[6] == '1') {
                        Serial.println("To12731");
                        sendRAW_Flash(To12731, sizeof(To12731)/sizeof(int),38);
                      }
                    }
                  } else
                  if (finalResult[5] == '2') {
                    if (finalResult[6] == '0') {
                      Serial.println("To12720");
                      sendRAW_Flash(To12720, sizeof(To12720)/sizeof(int),38);
                    }else {
                      if (finalResult[6] == '1') {
                        Serial.println("To12721");
                        sendRAW_Flash(To12721, sizeof(To12721)/sizeof(int),38);
                      }
                    }
                  } else
                  if (finalResult[5] == '1') {
                    if (finalResult[6] == '0') {
                      Serial.println("To12710");
                      sendRAW_Flash(To12710, sizeof(To12710)/sizeof(int),38);
                    }else {
                      if (finalResult[6] == '1') {
                        Serial.println("To12711");
                        sendRAW_Flash(To12711, sizeof(To12711)/sizeof(int),38);
                      }
                    }
                  }
                } else 
                if ((finalResult[3] == '2') and (finalResult[4] == '6')) {
                  if (finalResult[5] == '4') {
                    if (finalResult[6] == '0') {
                      Serial.println("To12640");
                      sendRAW_Flash(To12640, sizeof(To12640)/sizeof(int),38);
                    }else {
                      if (finalResult[6] == '1') {
                        Serial.println("To12641");
                        sendRAW_Flash(To12641, sizeof(To12641)/sizeof(int),38);
                      }
                    }
                  } else 
                  if (finalResult[5] == '3') {
                    if (finalResult[6] == '0') {
                      Serial.println("To12630");
                      sendRAW_Flash(To12630, sizeof(To12630)/sizeof(int),38);
                    }else {
                      if (finalResult[6] == '1') {
                        Serial.println("To12631");
                        sendRAW_Flash(To12631, sizeof(To12631)/sizeof(int),38);
                      }
                    }
                  } else
                  if (finalResult[5] == '2') {
                    if (finalResult[6] == '0') {
                      Serial.println("To12620");
                      sendRAW_Flash(To12620, sizeof(To12620)/sizeof(int),38);
                    } else {
                      if (finalResult[6] == '1') {
                        Serial.println("To12621");
                        sendRAW_Flash(To12621, sizeof(To12621)/sizeof(int),38);
                      }
                    }
                  } else
                  if (finalResult[5] == '1') {
                    if (finalResult[6] == '0') {
                      Serial.println("To12610");
                      sendRAW_Flash(To12610, sizeof(To12610)/sizeof(int),38);
                    } else {
                      if (finalResult[6] == '1') {
                        Serial.println("To12611");
                        sendRAW_Flash(To12611, sizeof(To12611)/sizeof(int),38);
                      }
                    }
                  }
                } else
                if ((finalResult[3] == '2') and (finalResult[4] == '5')) {
                  if (finalResult[5] == '4') {
                    if (finalResult[6] == '0') {
                      Serial.println("To12540");
                      sendRAW_Flash(To12540, sizeof(To12540)/sizeof(int),38);
                    } else {
                      if (finalResult[6] == '1') {
                        Serial.println("To12541");
                        sendRAW_Flash(To12541, sizeof(To12541)/sizeof(int),38);
                      }
                    }
                  } else 
                  if (finalResult[5] == '3') {
                    if (finalResult[6] == '0') {
                      Serial.println("To12530");
                      sendRAW_Flash(To12530, sizeof(To12530)/sizeof(int),38);
                    } else {
                      if (finalResult[6] == '1') {
                        Serial.println("To12531");
                        sendRAW_Flash(To12531, sizeof(To12531)/sizeof(int),38);
                      }
                    }
                  } else
                  if (finalResult[5] == '2') {
                    if (finalResult[6] == '0') {
                      Serial.println("To12520");
                      sendRAW_Flash(To12520, sizeof(To12520)/sizeof(int),38);
                    } else {
                      if (finalResult[6] == '1') {
                        Serial.println("To12521");
                        sendRAW_Flash(To12521, sizeof(To12521)/sizeof(int),38);
                      }
                    }
                  } else
                  if (finalResult[5] == '1') {
                    if (finalResult[6] == '0') {
                      Serial.println("To12510");
                      sendRAW_Flash(To12510, sizeof(To12510)/sizeof(int),38);
                    } else {
                      if (finalResult[6] == '1') {
                        Serial.println("To12511");
                        sendRAW_Flash(To12511, sizeof(To12511)/sizeof(int),38);
                      }
                    }
                  }
                }
              }
            }
      }
}
// 
//------------------------------------------------------------
bool convertToACVariableName(char brand[],char Mode[],char temperature[], char fanLevel[], char swing[]) {
  bool isValid = true;
  char bufB[3] = "00";
  if ((brand[0] == 'T') and (brand[1] == 'o') and (brand[2] == 's') and (brand[3] == 'h') and (brand[4] == 'i') and (brand[5] == 'b') and (brand[6] == 'a'))
    {snprintf(bufB, 3,"To");}
  else if ((brand[0] == 'P') and (brand[1] == 'a') and (brand[2] == 'n') and (brand[3] == 'a') and (brand[4] == 's') and (brand[5] == 'o') and (brand[6] == 'n') and (brand[7] == 'i') and (brand[8] == 'c'))
    {snprintf(bufB, 3,"Pa");}
  else if ((brand[0] == 'D') and (brand[1] == 'a') and (brand[2] == 'i') and (brand[3] == 'k') and (brand[4] == 'i') and (brand[5] == 'n'))
    {snprintf(bufB, 3,"Da");}
  else {isValid == false;}
  
  char bufM[2] = "0";
  if ((Mode[0] == 'C') and (Mode[1] == 'o') and (Mode[2] == 'o') and (Mode[3] == 'l'))
    {snprintf(bufM, 2,"1");}
  else if ((Mode[0] == 'D') and (Mode[1] == 'r') and (Mode[2] == 'y'))
    {snprintf(bufM, 2,"2");}
  else if ((Mode[0] == 'F') and (Mode[1] == 'a') and (Mode[2] == 'n'))
    {snprintf(bufM, 2,"3");}
  else if ((Mode[0] == 'A') and (Mode[1] == 'u') and (Mode[2] == 't') and (Mode[3] == 'o'))
    {snprintf(bufM, 2,"4");}
  else {isValid == false;}

  char bufF[2] = "0";
  if ((fanLevel[0] == 'M') and (fanLevel[1] == 'i') and (fanLevel[2] == 'n')) {snprintf(bufF, 2,"1");}
  else if ((fanLevel[0] == 'M') and (fanLevel[1] == 'e') and (fanLevel[2] == 'd')) {snprintf(bufF, 2,"2");}
  else if ((fanLevel[0] == 'M') and (fanLevel[1] == 'a') and (fanLevel[2] == 'x')) {snprintf(bufF, 2,"3");}
  else if ((fanLevel[0] == 'A') and (fanLevel[1] == 'u') and (fanLevel[2] == 't') and (fanLevel[3] == 'o')) {snprintf(bufF, 2,"4");}
  else {isValid == false;}

  char bufS[2] = "0";
  if ((swing[0] == 'O') and (swing[1] == 'f')) {snprintf(bufS, 2,"0");}
  else if ((swing[0] == 'O') and (swing[1] == 'n')) {snprintf(bufS, 2,"1");}
  else {isValid == false;}

  if (isValid) {
    snprintf(finalResult, 10,"%s%s%s%s%s",bufB,bufM,temperature,bufF,bufS);
    Serial.print("Covert to variable Name: ");Serial.println(finalResult);
    return true;
    isDefinedCommand = true;
  } else {
    snprintf(finalResult, 10,"failed");
    return false;
    isDefinedCommand = false;
  }
}
//-------------------END PROCEDURE------------------------------
//PROCEDURE: CONVERT WF REQUEST TO WF VARIABLE NAME
//------------------------------------------------------------
//PROCESS BY DATE:
// JUL22,2016: convert brand Mitshubishi/Panasonic/Daikin to 2 first letters of brand; then with command in 2 letters.(
//    
// 
//------------------------------------------------------------
//-------------------END PROCEDURE------------------------------
//------------------------------------------------------------
//PROCEDURE: EMIT DATA FROM FLASH TO IR PIN
//------------------------------------------------------------
//PROCESS BY DATE:
// JUL22,2016: CREATED DATE LONG CODE SUPPORTED LENGTH = 600
//    
// 
//------------------------------------------------------------
void sendRAW_Flash(const unsigned int * signalArray, unsigned int signalLength, unsigned char carrierFreq) {

  irsend.enableIROut(carrierFreq); //initialise the carrier frequency for each signal to be sent
  
  for (unsigned int i=0;i<signalLength;i++){
    //tmp=pgm_read_word_near(&signalArray[i]);
   // tmp=cleanPanasonic(tmp); //not needed
    if (i & 1) irsend.space(pgm_read_word_near(&signalArray[i]));
    else irsend.mark(pgm_read_word_near(&signalArray[i]));
  }
  irsend.space(1);//make sure IR is turned off at end of signal

}
//-------------------END PROCEDURE------------------------------
//------------------------------------------------------------
//PROCEDURE: PARSING DATA OF RECEIVED MESSAGE IN WF JSON FORMAT WITH WF SYNTAX
//------------------------------------------------------------
//PROCESS BY DATE:
// JUL22,2016: CREATED DATE - JSON SYNTAX LOOKS LIKE = {"ID":"Panasonic","command":"power"} //command= power; speed; timer; oscil; rhyth
//  
// 
//------------------------------------------------------------
bool readReceivedMsgInWFJson (char inputString[]) {
  DynamicJsonBuffer  jsonBuffer;
  JsonObject& root = jsonBuffer.parseObject(inputString);

  // Test if parsing succeeds.
  if (!root.success()) {
    Serial.println("parseObject() failed");
    return false;
  }
  // Fetch values.
    snprintf(WFID, 20, root["Brand"]);
    snprintf(WFCommand, 7, root["command"]);

    Serial.println("Parsed Received Message successfully!");
    Serial.println("Variables:");
    Serial.print("WFID :"); Serial.println(WFID);
    Serial.print("WFCommand :"); Serial.println(WFCommand);
    return true;
}
//-------------------END PROCEDURE------------------------------
//------------------------------------------------------------
//PROCEDURE: PARSING DATA OF RECEIVED MESSAGE IN AC JSON FORMAT WITH AC SYNTAX
//------------------------------------------------------------
//PROCESS BY DATE:
// JUL22,2016: CREATED DATE - JSON SYNTAX LOOKS LIKE = {"DT":"AC/WF","B":"Toshiba","State":"on","M":"cool","T":"27","fanF":"max","S":"n"}
//    
// 
//------------------------------------------------------------
bool readReceivedMsgInACJson (char inputString[]) {
  DynamicJsonBuffer  jsonBuffer;
  JsonObject& root = jsonBuffer.parseObject(inputString);

  // Test if parsing succeeds.
  if (!root.success()) {
    Serial.println("parseObject() failed");
    return false;
  }
  // Fetch values.
    snprintf(ACID, 20, root["B"]);
    snprintf(ACstate, 4, root["State"]);
    snprintf(ACmode, 5, root["M"]);
    snprintf(ACtemp, 3, root["T"]);
    snprintf(ACfan, 5, root["F"]);
    snprintf(ACswing, 4, root["S"]);

    Serial.println("Parsed Received Message successfully!");
    Serial.println("Variables:");
    Serial.print("ACID :"); Serial.println(ACID);
    Serial.print("ACstate :"); Serial.println(ACstate);
    Serial.print("ACmode :"); Serial.println(ACmode);
    Serial.print("ACtemp :"); Serial.println(ACtemp);
    Serial.print("ACfan :"); Serial.println(ACfan);
    Serial.print("ACswing :"); Serial.println(ACswing);
    return true;
}

bool readReceivedMsgInJson (char inputString[]) {
  DynamicJsonBuffer  jsonBuffer;
  JsonObject& root = jsonBuffer.parseObject(inputString);
  Serial.println ("JsonObject root");
  // Test if parsing succeeds.
  if (!root.success()) {
    Serial.println("parseObject() failed");
    return false;
  } else {
  // Fetch values.
    snprintf(ID, 20, root["B"]);
    snprintf(DeviceType, 5, root["DT"]);

    Serial.println("Parsed Received Message successfully!");
    Serial.println("Variables:");
    Serial.print("Brand:"); Serial.println(ID);
    Serial.print("DeviceType:"); Serial.println(DeviceType);

    return true;
  }
}
//-------------------END PROCEDURE------------------------------
//------------------------------------------------------------
//PROCEDURE: VERIFY RECEIVED MESSAGE IS FOR CONTROLLING NODE
//------------------------------------------------------------
//PROCESS BY DATE:
// JUL22,2016: CREATED DATE
// the general received message will following format:
// {"DeviceType":"<kind>","Brand":"","state":"on","mode":"cool","temp":"27","fan":"max","swing":"n"}
// Required Parameter: "DeviceType", "Brand", "state"
// Optional Parameter for AC: mode, temp, fan, swing
// Optional Parameter for WF: command
//------------------------------------------------------------
//SendConfirm () will send feedback to MQTT to confirm the command 
//---------------
void sendConfirmtoRetained (char inputString[]) {
  firstTime = false;
  Serial.print("Message send: ");
  Serial.println(inputString);
  client.publish(pubTopicGen, inputString, true);
}
void adjustDaikinAC() {

  //STATE ON or OFF
  if (ACstate[0] == 'O' and ACstate[1] == 'n') { dakinir.on();} 
  else if (ACstate[0] == 'O' and ACstate[1] == 'f' and ACstate[2] == 'f') { dakinir.off();} 

  //set Mode
  if (ACmode[0] == 'C' and ACmode[1] == 'o' and ACmode[2] == 'o' and ACmode[3] == 'l') {
    dakinir.setMode(DAIKIN_COOL);
  } else
  if (ACmode[0] == 'H' and ACmode[1] == 'e' and ACmode[2] == 'a' and ACmode[3] == 't') {
    dakinir.setMode(DAIKIN_HEAT);
  } else
  if (ACmode[0] == 'F' and ACmode[1] == 'a' and ACmode[2] == 'n') {
    dakinir.setMode(DAIKIN_FAN);
  } else
  if (ACmode[0] == 'A' and ACmode[1] == 'u' and ACmode[2] == 'y' and ACmode[3] == 'o') {
    dakinir.setMode(DAIKIN_AUTO);
  } else
  if (ACmode[0] == 'D' and ACmode[1] == 'r' and ACmode[2] == 'y') {
    dakinir.setMode(DAIKIN_DRY);
  }

  //Set FAN
  if (ACfan[0] == 'M' and ACfan[1] == 'a' and ACfan[2] == 'x') {
    dakinir.setFan(5);
  } else
  if (ACfan[0] == 'M' and ACfan[1] == 'e' and ACfan[2] == 'd') {
    dakinir.setFan(3);
  } else
  if (ACfan[0] == 'M' and ACfan[1] == 'i' and ACfan[2] == 'n') {
    dakinir.setFan(1);
  } else
  if (ACfan[0] == 'A' and ACfan[1] == 'u' and ACfan[2] == 't') {
    dakinir.setFan(0);
  } else

  //Set SWING  VERTICAL
  if (ACswing[0] == 'y' and ACswing[1] == 'e' and ACswing[2] == 's') {
    dakinir.setSwingVertical(1);
  } else
  if (ACswing[0] == 'n' and ACswing[1] == 'o') {
    dakinir.setSwingVertical(0);
  }

  //set Temp
  int temptACTemp = (ACtemp[0] - '0') * 10 + (ACtemp[1] - '0');
  Serial.println(temptACTemp);
  dakinir.setTemp(temptACTemp);

  dakinir.send();
}

void keepAlive (char inputString[]) {
//-------------------------------------
//keep-alive interval to update node status
//There is 2 states of interval
//1_active when ping frequently
//2_reconnecting when re-connect
//------------------------------------
  char publishMessage [100] = "";
  snprintf(publishMessage, 100, "{\"NodeMacAddress\":\"%02X:%02X:%02X:%02X:%02X:%02X\",\"State\":\"%s\"}",mac[0],mac[1],mac[2],mac[3],mac[4],mac[5], inputString);
  Serial.print("Message send: ");
  Serial.println(publishMessage);
  char keepAliveTopic [55] = "";
  snprintf(keepAliveTopic, 55,"%s/keepAlive",pubTopicGen);
  client.publish(keepAliveTopic, publishMessage, true);
}
//------------------------------------
void isControlNode(char inputString[]) {
  char breakedValue[150] = "";
  char breakedValue1[150] = "";
  char breakedValue2[150] = "";
  int check = 0;
  int countSpace = 0;
  int i = 0;
  int j = 0;
  int countOfChar = 0;

  //Remove All un-needed # command from received message
  while (inputString[i] != '#') {
                breakedValue[i] = inputString[i];
                breakedValue1[i] = inputString[i];
                breakedValue2[i] = inputString[i];
                i++;
  }
  //call parse data from payload under JSON
  Serial.println(breakedValue);
  readReceivedMsgInJson(breakedValue);
  //Checking the device is AC or WF or else to break other JSON parameters following kinds
  Serial.println(breakedValue1);
  
  if ((DeviceType[0] == 'A') and (DeviceType[1] == 'C')) {
    Serial.println(breakedValue1);
    readReceivedMsgInACJson(breakedValue1);
    if ((ACID[0] == 'D') and (ACID[1] == 'a') and (ACID[2] == 'i') and (ACID[3] == 'k')and (ACID[4] == 'i') and (ACID[5] == 'n')) {
      adjustDaikinAC();
    } 
    else if ((ACID[0] == 'T') and (ACID[1] == 'o') and (ACID[2] == 's') and (ACID[3] == 'h')and (ACID[4] == 'i') and (ACID[5] == 'b')) {
      adjustAC();
//      adjustToshibaAC();
    }
    sendConfirmtoRetained(breakedValue2);
  } else if ((DeviceType[0] == 'W') and (DeviceType[1] == 'F')) {
    Serial.println(breakedValue1);
    readReceivedMsgInWFJson(breakedValue1);
    adjustWF();
    sendConfirmtoRetained(breakedValue2);
  } else {
    isDefinedCommand = false;
  } 
}
//------------------------------------------------------------
//PROCEDURE: VERIFY RECEIVED MESSAGE IS FOR CONTROLLING AC
//------------------------------------------------------------
//PROCESS BY DATE:
// JUL22,2016: CREATED DATE
// 
//------------------------------------------------------------
//-------------------END PROCEDURE------------------------------


//-----void callback description----
//If the client is used to subscribe to topics, a callback function must be provided in the constructor.
//This function is called when new messages arrive at the client.
//topic - the topic the message arrived on (const char[])
//payload - the message payload (byte array)
//length - the length of the message payload (unsigned int)
//-----------------------------------
void callback(char* topic, byte* payload, unsigned int length) {
  for (int i = 0; i < 150; i++) {
    subMsg[i] = '#';
  }
  Serial.print("Message arrived from [");
  Serial.print(mqttServer);
  Serial.print("] ;topic: [");
  Serial.print(topic);
  Serial.print("] with payload: [");
  for (int i = 0; i < length; i++) {
    Serial.print((char)payload[i]);
    subMsg[i] = (char)payload[i];
  }
  Serial.print("]");
  Serial.println();
////--------detect command-----------
  isDefinedCommand = false;
  if (!isDefinedCommand) { isControlNode(subMsg); }
  if (!isDefinedCommand) {
      char temptCommand[200] = "";
      char breakedValue[150] = "";
      int i = 0;
      int countOfChar = 0;
      //Remove All un-needed # command from received message
      while (subMsg[i] != '#') {
                breakedValue[i] = subMsg[i];
                i++;
      }     
      snprintf (temptCommand, 200, "[%s]: NO SYNTAX FOUND", breakedValue);
  }
}
//----------END void callback -----------------------
//callback notifying us of the need to save config
void saveConfigCallback () {
  Serial.println("Should save config");
  shouldSaveConfig = true;
}

/**
  setup_wifi to config wifi after user change setup
  @param: nope
  @return nope
  @version 1.0
  @author Tri Nguyen
  @date June12017
*/
void setup_wifi() {
  delay(10);
  // We start by connecting to a WiFi network
  Serial.println();
  Serial.print("Trying connect to ");
  Serial.println(APssid);
  WiFi.mode(WIFI_STA);
  WiFi.begin(APssid, APpassword);
  delay(5000);
  //if you get here you have connected to the WiFi
  if (WiFi.status() == WL_CONNECTED) {
    checkWifi = true;   
    Serial.print("Connected at IP ");
    Serial.println(WiFi.localIP());
    WiFi.macAddress(mac);
    Serial.print("MAC: ");
    Serial.print(mac[0],HEX);
    Serial.print(":");
    Serial.print(mac[1],HEX);
    Serial.print(":");
    Serial.print(mac[2],HEX);
    Serial.print(":");
    Serial.print(mac[3],HEX);
    Serial.print(":");
    Serial.print(mac[4],HEX);
    Serial.print(":");
    Serial.println(mac[5],HEX);   
    snprintf(temptMac, 20, "SPL-%02X%02X%02X%02X%02X%02X", mac[0], mac[1], mac[2], mac[3], mac[4], mac[5]);
    Serial.println("Connecting to MQTT");
    Serial.print("MQTT SERVER: "); Serial.print(mqttServer);
    Serial.print(" MQTT PORT: "); Serial.println(mqttPort);
    client.setServer(mqttServer, atoi(mqttPort)); //April23
    client.setCallback(callback); //April23
    snprintf (pubTopicGen, 50, "%s/%s/state", projectName, temptMac);
    snprintf (subTopicGen, 50, "%s/%s/set", projectName, temptMac);
    Serial.print("Default Publish Topic: "); Serial.println(pubTopicGen);
    Serial.print("Default Subscribe Topic: "); Serial.println(subTopicGen);
    reconnect(); //run for 1st register message
    ArduinoOTA.onStart([]() {
      Serial.println("Start");
    });
    ArduinoOTA.onEnd([]() {
      Serial.println("\nEnd");
    });
    ArduinoOTA.onProgress([](unsigned int progress, unsigned int total) {
      Serial.printf("Progress: %u%%\r", (progress / (total / 100)));
    });
    ArduinoOTA.onError([](ota_error_t error) {
      Serial.printf("Error[%u]: ", error);
      if (error == OTA_AUTH_ERROR) Serial.println("Auth Failed");
      else if (error == OTA_BEGIN_ERROR) Serial.println("Begin Failed");
      else if (error == OTA_CONNECT_ERROR) Serial.println("Connect Failed");
      else if (error == OTA_RECEIVE_ERROR) Serial.println("Receive Failed");
      else if (error == OTA_END_ERROR) Serial.println("End Failed");
    });
    ArduinoOTA.begin();
  }
  else {
    Serial.print("Failed connect to AP. Code: ");
    Serial.println(WiFi.status());
    checkWifi = false;
    pixels.setPixelColor(0, pixels.Color(255, 255, 0)); // RED+GREEN = YELLOW = Wifi DISCONNECTING...
    pixels.show();
  }
}

/**
  recoonect to check wifi status and mqtt connection to avoid send message when network is down
  @param: nope
  @return nope

  @version 1.0
  @author Tri Nguyen
  @date June12017

*/
void reconnect() {
  // Loop until we're reconnected
    client.connect(temptMac);
    Serial.print("Attempting MQTT connection...using clientID: ");
    Serial.print(temptMac);
    Serial.print(" Result: ");
    // Attempt to connect
    if (client.connected()) {
      Serial.println("connected");
      pixels.setPixelColor(0, pixels.Color(0, 0, 255)); // BLUE: done setup - GOOD STATE
      pixels.show();
      // Once connected, publish an announcement...
      char registerMessage[100] = "";
      snprintf (registerMessage, 100, "{\"ID\":\"%s\",\"type\":\"%s\",\"project\":\"%s\"}", temptMac,"IRControl",projectName);
      char defaultTopic[50] = "";
      snprintf (defaultTopic, 50, "%s/RegisterDevices", projectName);
      client.publish(defaultTopic, registerMessage, true);
      delay(200);
      // ... and resubscribe
      Serial.print("Sent register message: ");  Serial.print(registerMessage);  Serial.print(" to ");  Serial.println(defaultTopic);
      delay(200);
      client.subscribe(subTopicGen);
      mqttReconnecting = false;
    }
    else {
      pixels.setPixelColor(0, pixels.Color(255, 0, 255)); // PINK: error in connecting MQTT server
      pixels.show();
      Serial.print("failed, rc=");
      Serial.print(client.state());
      Serial.println(" try again in 10 seconds");
      mqttReconnecting = true;
    }
  }
  
void setup() {
  //insert your own setup code here
    irsend.begin();
    dakinir.begin();
    Serial.begin(115200);
    pixels.begin(); // This initializes the NeoPixel library.
    pinMode(SOFT_RST_PIN, INPUT);
      //clean FS, for testing
//    SPIFFS.format();

//--------Read Congiguration file-----------
  Serial.println("mounting FS...");
  pixels.setPixelColor(0, pixels.Color(255, 0, 0)); // RED: SETUP
  pixels.show();
  if (SPIFFS.begin()) {
    Serial.println("mounted file system");
    if (SPIFFS.exists("/config.json")) {
      //file exists, reading and loading
      Serial.println("reading config file");
      File configFile = SPIFFS.open("/config.json", "r");
      if (configFile) {
        factoryReset = false;
        Serial.println("opened config file");
        size_t size = configFile.size();
        // Allocate a buffer to store contents of the file.
        std::unique_ptr<char[]> buf(new char[size]);
        configFile.readBytes(buf.get(), size);
        DynamicJsonBuffer jsonBuffer;
        JsonObject& json = jsonBuffer.parseObject(buf.get());
        json.printTo(Serial);
        if (json.success()) {
          Serial.println("\nparsed config parameters");
          strcpy(APssid, json["APssid"]);
          strcpy(APpassword, json["APpassword"]);          
          strcpy(mqttServer, json["mqttServer"]);
          strcpy(mqttPort, json["mqttPort"]);
          strcpy(projectName, json["projectName"]);
//          strcpy(subTopicGen, json["subTopicGen"]);
          setup_wifi();
          factoryReset = false;
        } else {
          Serial.println("failed to load json config");
          factoryReset = true;
        }
    } else {
      Serial.println("File Config has not created");
      factoryReset = true;
    }
  }
  else {
    Serial.println("failed to mount FS");
    factoryReset = true;
  }
}
//--------END Read Congiguration file-----------
}

void loop() {
  WiFiManager wifiManager;
  // read the state of the switch into a local variable:
  int reading = digitalRead(SOFT_RST_PIN);
  if (WiFi.status() == WL_CONNECTED) {
    ArduinoOTA.handle();
  }
  // check to see if you just pressed the button
  // (i.e. the input went from LOW to HIGH),  and you've waited
  // long enough since the last press to ignore any noise:
  // If the switch changed, due to noise or pressing:

  if (reading != lastButtonState) {
    // reset the debouncing timer
    lastDebounceTime = millis();
  }

 //--------RESET WIFI CONFIGURATION-------------------------------
  if ((factoryReset == true) or ((millis() - lastDebounceTime) > debounceDelay)) {
    Serial.println("ACCESSING WIFI DIRECT - AP");
    //WiFiManager
    //reset saved settings
    wifiManager.resetSettings();
    delay(2000);
    //sets timeout until configuration portal gets turned off
    //useful to make it all retry or go to sleep
    //in seconds
    pixels.setPixelColor(0, pixels.Color(0, 255, 0)); //GREEN: WIFI CONFIGURE
    pixels.show();
    // The extra parameters to be configured (can be either global or just in the setup)
    // After connecting, parameter.getValue() will get you the configured value
    // id/name placeholder/prompt default length
    WiFiManagerParameter custom_mqttServer("server", "MQTT Server", mqttServer, 40);
    WiFiManagerParameter custom_mqttPort("port", "MQTT Port", mqttPort, 5);
    //    WiFiManagerParameter custom_blynk_token("blynk", "blynk token", blynk_token, 32);
    WiFiManagerParameter AP_password("p", "password of SSID", APpassword, 20);
    WiFiManagerParameter custom_project_name("projectName", "Project Name", projectName , 40);
//    WiFiManagerParameter custom_GeneralPublish_topic("pubTopicGen", "GeneralPublish_topic", pubTopicGen, 40);
    //set config save notify callback
    wifiManager.setSaveConfigCallback(saveConfigCallback);
    //exit after config instead of connecting
    wifiManager.setBreakAfterConfig(true);

    //add all your parameters here
    wifiManager.addParameter(&AP_password);
    wifiManager.addParameter(&custom_mqttServer);
    wifiManager.addParameter(&custom_mqttPort);
//    wifiManager.addParameter(&custom_blynk_token);
    wifiManager.addParameter(&custom_project_name);
//    wifiManager.addParameter(&custom_GeneralPublish_topic);
    
    WiFi.macAddress(mac);
    char temptSSID [20] = "";
    snprintf(temptSSID, 20, "SPL-%02X%02X%02X%02X%02X%02X", mac[0], mac[1], mac[2], mac[3], mac[4], mac[5]);
    Serial.println(temptSSID);

    if (!wifiManager.autoConnect(temptSSID, password)) {
      Serial.println("failed to connect existing SSID ...");
    }
    else {
      //read updated parameters
      WiFi.status();
      strcpy(mqttServer, custom_mqttServer.getValue());
      strcpy(mqttPort, custom_mqttPort.getValue());
      //      strcpy(blynk_token, custom_blynk_token.getValue());
      strcpy(APpassword, AP_password.getValue());
      strcpy(projectName, custom_project_name.getValue());
//      strcpy(pubTopicGen, custom_GeneralPublish_topic.getValue());
      //save the custom parameters to FS
      if (shouldSaveConfig) {
        Serial.println("saving config");
        DynamicJsonBuffer jsonBuffer;
        JsonObject& json = jsonBuffer.createObject();
        json["APssid"] = WiFi.SSID();
        json["APpassword"] = APpassword;
        json["mqttServer"] = mqttServer;
        json["mqttPort"] = mqttPort;
        json["projectName"] = projectName;
//        json["pubTopicGen"] = pubTopicGen;
        File configFile = SPIFFS.open("/config.json", "w");
        if (!configFile) {
          Serial.println("failed to open config file for writing");
        }
        json.printTo(Serial);
        json.printTo(configFile);
        configFile.close();
        Serial.println();
        //end save
        pixels.setPixelColor(0, pixels.Color(0, 255, 0)); //BLUE GOOD
        pixels.show();
      }

      ESP.reset();
      delay(2000);
    }
  }
  //-----------END RESET--------------------
  //---START WI4341-----------------------------------------------------
  //Description: Mode Wifi Client : Loop Authen until successful
  if (mqttReconnecting) {
    if ((simulatedDropedWifi) or (WiFi.status() != WL_CONNECTED)) {
      checkWifi = false;
    }
    else {
      checkWifi = true;
    }
  }
  //----STOP WI4341----------------------------------------------------
//Send response after receiving command from broker
    if (checkWifi == true) {
      unsigned long currentMillis3 = millis();
      if (currentMillis3 - previousMillis3 > publishInveral) {
        previousMillis3 = currentMillis3;
        unsigned long currentMillis4 = millis();
        if (client.connected()) {
          char temptCommand[] = "Active";
//          keepAlive(temptCommand);   
      }
      else {
        if ((currentMillis4 - previousMillis4 > reconnectInveral)) {
        previousMillis4 = currentMillis4;
        reconnect();
        }
      }
    }
    client.loop();
  } else {
    setup_wifi();
  }
}


